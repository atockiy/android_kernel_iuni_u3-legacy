## drivers/misc/gn/Kconfig
```kconfig
menu "Gionee specific support for the IUNI U3"

##############################################
# GIONEE'S KERNEL FLAGS ENABLED BY DEFAULT	 #
##############################################

config GN_Q_BSP_BACKLIGHT_LM3630_SUPPORT
	bool "GN_Q_BSP_BACKLIGHT_LM3630_SUPPORT"
	default y

config GN_Q_BSP_LCD_TPS65132_SUPPORT
	bool "GN_Q_BSP_LCD_TPS65132_SUPPORT"
	default y

config GN_Q_BSP_LCD_RESET_SUPPORT
	bool "GN_Q_BSP_LCD_RESET_SUPPORT"
	default y

config GN_Q_BSP_LCD_IOVCC_CONTROL_SUPPORT
	bool "GN_Q_BSP_LCD_IOVCC_CONTROL_SUPPORT"
	default y

config GN_Q_BSP_LCD_TE_ANALOG_SUPPORT
	bool "GN_Q_BSP_LCD_TE_ANALOG_SUPPORT"
	default y

config GN_CAMERA_SUPPORT
	bool "GN_CAMERA_SUPPORT"
	default y

config GN_Q_BSP_AUDIO_HEADSET_SUPPORT
	bool "GN_Q_BSP_AUDIO_HEADSET_SUPPORT"
	default y

config GN_Q_BSP_PM_CHG_DEBUG_SUPPORT
	bool "GN_Q_BSP_PM_CHG_DEBUG_SUPPORT"
	default y

config GN_Q_BSP_AUDIO_MBHC_CALIBRATION 
	bool "GN_Q_BSP_AUDIO_MBHC_CALIBRATION"
	default y

config GN_Q_BSP_ISA1200_QPNPCLK_SUPPORT
	bool "GN_Q_BSP_ISA1200_QPNPCLK_SUPPORT"
	default y

config GN_Q_BSP_ISA1200_LEVEL_SUPPORT
	bool "GN_Q_BSP_ISA1200_LEVEL_SUPPORT"
	default y

config GN_Q_BSP_PMIC_DISABLE_LOW_TM_INTERRUPTS_SUPPORT
	bool "GN_Q_BSP_PMIC_DISABLE_LOW_TM_INTERRUPTS_SUPPORT"
	default y

config GN_Q_BSP_PM_NON_STANDARD_CHARGER_SUPPORT
	bool "GN_Q_BSP_PM_NON_STANDARD_CHARGER_SUPPORT"
	default y

config GN_Q_BSP_PM8941_CHARGER_SUPPORT
	bool "GN_Q_BSP_PM8941_CHARGER_SUPPORT"
	default y

config GN_Q_BSP_CHARGE_VOLTAGE_SUPPORT
	bool "GN_Q_BSP_CHARGE_VOLTAGE_SUPPORT"
	default y

config GN_Q_BSP_BATTERY_10K_NTC_SUPPORT
	bool "GN_Q_BSP_BATTERY_10K_NTC_SUPPORT"
	default y

config GN_Q_BSP_BTC_CONFIG_SUPPORT
	bool "GN_Q_BSP_BTC_CONFIG_SUPPORT"
	default y

config GN_Q_BSP_OVP_9P5V_SUPPORT
	bool "GN_Q_BSP_OVP_9P5V_SUPPORT"
	default y

config GN_Q_BSP_PM_BMS_LOG_SUPPORT
	bool "GN_Q_BSP_PM_BMS_LOG_SUPPORT"
	default y

config GN_Q_BSP_OPTIMIZE_SOC_SUPPORT
	bool "GN_Q_BSP_OPTIMIZE_SOC_SUPPORT"
	default y

config GN_Q_BSP_LK_DISABLE_EMMC_HS400 
	bool "GN_Q_BSP_LK_DISABLE_EMMC_HS400"
	default y

config GN_Q_BSP_ENFORCE_EMMC_TIMEOUT_SUPPORT
	bool "GN_Q_BSP_ENFORCE_EMMC_TIMEOUT_SUPPORT"
	default y

##############################################
# GIONEE'S KERNEL FLAGS DISABLED BY DEFAULT	 #
##############################################

config GN_CDROM_SUPPORT
	bool "GN_CDROM_SUPPORT"
	default n
	
config GN_Q_BSP_BMS_OPTIMIZE_PHONE_RESTART_SOC_SUPPORT
	bool "GN_Q_BSP_BMS_OPTIMIZE_PHONE_RESTART_SOC_SUPPORT"
	default n

config GN_Q_BSP_BMS_OPTIMIZE_SOC_SUPPORT
	bool "GN_Q_BSP_BMS_OPTIMIZE_SOC_SUPPORT"
	default n

config GN_Q_BSP_DEVICE_TYPE_CHECK_SUPPORT
	bool "GN_Q_BSP_DEVICE_TYPE_CHECK_SUPPORT"
	default n

config GN_Q_BSP_NO_DOWNLOAD_MODE
	bool "GN_Q_BSP_NO_DOWNLOAD_MODE"
	default n

######################################################################
# GIONEE'S FLAGS PRESENT OUTSIDE OF THE KERNEL & ENABLED BY DEFAULT  #
######################################################################
#																	 #
#config GN_Q_BSP_LCD_COMPATIBILITY_SUPPORT						 	 #
#	bool "GN_Q_BSP_LCD_COMPATIBILITY_SUPPORT"					  	 #
#	default y													  	 #
#																  	 #
#config GN_Q_BSP_LCD_CABC_CHANGE_SUPPORT							 #
#	bool "GN_Q_BSP_LCD_CABC_CHANGE_SUPPORT"						   	 #
#	default y													  	 #
#																  	 #
#config GN_Q_BSP_LCD_RESET_VOL_1V8_SUPPORT						  	 #
#	bool "GN_Q_BSP_LCD_RESET_VOL_1V8_SUPPORT"					   	 #
#	default y													   	 #
#																   	 #
#config GN_Q_BSP_LCD_TRULY_R63419_SUPPORT						   	 #
#	bool "GN_Q_BSP_LCD_TRULY_R63419_SUPPORT"					   	 #
#	default y													   	 #
#																   	 #
#config GN_Q_BSP_LCD_JDI_R63419_SUPPORT							   	 #
#	bool "GN_Q_BSP_LCD_JDI_R63419_SUPPORT"						   	 #
#	default y													  	 #
#																  	 #
#config GN_Q_BSP_LCD_SHARP_R63419_SUPPORT						  	 #
#	bool "GN_Q_BSP_LCD_SHARP_R63419_SUPPORT"					  	 #
#	default y													  	 #
#																  	 #
#config GN_Q_BSP_LCD_CHARGE_LOGO_SUPPORT						  	 #
#	bool "GN_Q_BSP_LCD_CHARGE_LOGO_SUPPORT"						  	 #
#	default y													  	 #
#																  	 #
#config GN_Q_BSP_WQHD_LCD_SUPPORT								  	 #
#	bool "GN_Q_BSP_WQHD_LCD_SUPPORT"							  	 #
#	default y													  	 #
#																  	 #
#config GN_Q_BSP_LCD_LK_DUAL_DSI_SUPPORT						  	 #
#	bool "GN_Q_BSP_LCD_LK_DUAL_DSI_SUPPORT"						  	 #
#	default y													  	 #
#																  	 #
#config GN_Q_BSP_LCD_LK_SPLASH_SUPPORT							  	 #
#	bool "GN_Q_BSP_LCD_LK_SPLASH_SUPPORT"						  	 #
#	default y													  	 #
#																  	 #
#config GN_CAMERA_24M_MCLOCK_SUPPORT							  	 #
#	bool "GN_CAMERA_24M_MCLOCK_SUPPORT"							  	 #
#	default y													  	 #
#																  	 #
#config GN_Q_BSP_PM_POWEROFF_CHG_SUPPORT						  	 #
#	bool "GN_Q_BSP_PM_POWEROFF_CHG_SUPPORT"						  	 #
#	default y													  	 #
#																  	 #
#config GN_Q_BSP_FACTORY_NV_SUPPORT								  	 #
#	bool "GN_Q_BSP_FACTORY_NV_SUPPORT"							  	 #
#	default y													  	 #
#																  	 #
#config GN_CAMERA_FEATURE_SUPPORT								  	 #
#	bool "GN_CAMERA_FEATURE_SUPPORT"							  	 #
#	default y													  	 #
#																  	 #
#config GN_SCALADO_FEATURE_SUPPORT								  	 #
#	bool "GN_SCALADO_FEATURE_SUPPORT"							  	 #
#	default y													  	 #
#																  	 #
#config GN_CAMERA_FEATURE_FACE_BEAUTY_SUPPORT					  	 #
#	bool "GN_CAMERA_FEATURE_FACE_BEAUTY_SUPPORT"				  	 #
#	default y													  	 #
#																  	 #
#config GN_CAMERA_FEATURE_LIVE_EFFECT_SUPPORT					  	 #
#	bool "GN_CAMERA_FEATURE_LIVE_EFFECT_SUPPORT"				  	 #
#	default y													  	 #
#																  	 #
#config GN_ARCSOFT_FEATURE_SUPPORT						 		  	 #
#	bool "GN_ARCSOFT_FEATURE_SUPPORT"							  	 #
#	default y													  	 #
#																  	 #
#config GN_Q_BSP_AUDIO_SUPPORT									  	 #
#	bool "GN_Q_BSP_AUDIO_SUPPORT"								  	 #
#	default y													  	 #
#																  	 #
#config GN_Q_BSP_AUDIO_MMI_TEST_SUPPORT							  	 #
#	bool "GN_Q_BSP_AUDIO_MMI_TEST_SUPPORT"						  	 #
#	default y													  	 #
#																  	 #
#config GN_Q_BSP_AUDIO_REMOVE_FASTMIXER_SUPPORT					  	 #
#	bool "GN_Q_BSP_AUDIO_REMOVE_FASTMIXER_SUPPORT"				  	 #
#	default y													  	 #
#																  	 #
#config GN_Q_BSP_USB_SUPPORT									  	 #
#	bool "GN_Q_BSP_USB_SUPPORT"									  	 #
#	default y													  	 #
#																  	 #
#config GN_Q_BSP_PS_CALIB_SUPPORT								  	 #
#	bool "GN_Q_BSP_PS_CALIB_SUPPORT"							  	 #
#	default y													  	 #
#																  	 #
#config GN_Q_BSP_PM_BMS_BATTERY_DATA_SUPPORT					  	 #
#	bool "GN_Q_BSP_PM_BMS_BATTERY_DATA_SUPPORT"					  	 #
#	default y													  	 #
#																  	 #
#config GN_Q_BSP_CLK_PWRKEY_VIBRATOR_SUPPORT					  	 #
#	bool "GN_Q_BSP_CLK_PWRKEY_VIBRATOR_SUPPORT"					  	 #
#	default y													  	 #
#																  	 #
#config GN_Q_BSP_LK_PWRKEY_CHECK_SUPPORT						  	 #
#	bool "GN_Q_BSP_LK_PWRKEY_CHECK_SUPPORT"						  	 #
#	default y													  	 #
#																  	 #
#config GN_Q_BSP_COPY_SNS_REG_FILE 								  	 #
#	bool "GN_Q_BSP_COPY_SNS_REG_FILE"							  	 #
#	default y													  	 #
#																  	 #
#config GN_Q_BSP_LK_RTC_ALARM_SUPPORT							  	 #
#	bool "GN_Q_BSP_LK_RTC_ALARM_SUPPORT"						  	 #
#	default y													  	 #
#																  	 #
#config GN_Q_BSP_KERNEL_RTC_ALARM_SUPPORT						  	 #
#	bool "GN_Q_BSP_KERNEL_RTC_ALARM_SUPPORT"					  	 #
#	default y													  	 #
#																  	 #
#config GN_Q_BSP_BAT_OPTIMIZE_LOW_TEMP_FUEL_GAUGE 				  	 #
#	bool "GN_Q_BSP_BAT_OPTIMIZE_LOW_TEMP_FUEL_GAUGE"			  	 #
#	default y													  	 #
#																  	 #
#config GN_Q_BSP_SAVE_POWEROFFCHG_LOG_SUPPORT					  	 #
#	bool "GN_Q_BSP_SAVE_POWEROFFCHG_LOG_SUPPORT"				  	 #
#	default y													  	 #
#																  	 #
#config GN_Q_BSP_CHINA_ECC_SUPPORT								  	 #
#	bool "GN_Q_BSP_CHINA_ECC_SUPPORT"							  	 #
#	default y													  	 #
#																  	 #
#config GN_Q_BSP_FASTBOOT_MODE_PROMPT_SUPPORT					  	 #
#	bool "GN_Q_BSP_FASTBOOT_MODE_PROMPT_SUPPORT"				  	 #
#	default y													  	 #
#																  	 #
#config GN_CAMERA_FEATURE_NIGHT_SHOT_SUPPORT					  	 #
#	bool "GN_CAMERA_FEATURE_NIGHT_SHOT_SUPPORT"					  	 #
#	default y													  	 #
#																  	 #
#config GN_SCALADO_MIRROR_SUPPORT								  	 #
#	bool "GN_SCALADO_MIRROR_SUPPORT"							  	 #
#	default y													  	 #
######################################################################

endmenu
```
